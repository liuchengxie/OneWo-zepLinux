## zephyr/boards/ansilic/as32x601_evb/as32x601_evb_as32x601_defconfig
```kconfig
CONFIG_RISCV=y
CONFIG_SOC_SERIES_AS32X601=y
CONFIG_SOC_AS32X601=y
CONFIG_BOARD_AS32X601_EVB=y
CONFIG_CONSOLE=y
CONFIG_SERIAL=y
CONFIG_UART_CONSOLE=y
CONFIG_GPIO=y
CONFIG_PINCTRL=y
CONFIG_PLIC=y
CONFIG_RISCV_MACHINE_TIMER=y
CONFIG_SYS_CLOCK_HW_CYCLES_PER_SEC=1000000
CONFIG_NUM_IRQS=128
```

## zephyr/boards/ansilic/as32x601_evb/board.yml
```yaml
board:
  name: as32x601_evb
  full_name: AS32X601 Evaluation Board
  vendor: ansilic
  socs:
    - name: as32x601
```

## zephyr/soc/ansilic/Kconfig
```kconfig
config SOC_FAMILY_ANSILIC
	bool
	select RISCV
	select RISCV_PRIVILEGED

if SOC_FAMILY_ANSILIC
rsource "*/Kconfig"
endif
```
